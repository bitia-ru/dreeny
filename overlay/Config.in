## overlay/Config.in
```kconfig
config Dreeny_BOARD_NAME
    string "Board name (DON'T TOUCH)"
    default default

source "$BR2_EXTERNAL_DREENY_PATH/package/Config.in"
source "$BR2_EXTERNAL_DREENY_PATH/package/Config.in.host"
```

## overlay/package/grub_config/Config.in
```kconfig
config BR2_PACKAGE_GRUB_CONFIG
        bool "grub_config"
        help
          http://globinform.ru/
```
